## boards/shields/lp_split/Kconfig.defconfig
```kconfig
if SHIELD_LP_SPLIT_LEFT

config ZMK_KEYBOARD_NAME
    default "LP_Split"

config ZMK_SPLIT_ROLE_CENTRAL
    default y

endif # SHIELD_LP_SPLIT_LEFT

if SHIELD_LP_SPLIT_LEFT || SHIELD_LP_SPLIT_RIGHT

config ZMK_SPLIT
    default y

endif # SHIELD_LP_SPLIT_LEFT || SHIELD_LP_SPLIT_RIGHT
```

## boards/shields/lp_split/Kconfig.shield
```kconfig
config SHIELD_LP_SPLIT_LEFT
    def_bool $(shields_list_contains,lp_split_left)

config SHIELD_LP_SPLIT_RIGHT
    def_bool $(shields_list_contains,lp_split_right)
```
